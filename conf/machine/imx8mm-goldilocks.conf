## conf/machine/imx8mm-goldilocks.conf
```bitbake
require conf/machine/imx8mm-ddr4-evk.conf

MACHINEOVERRIDES =. "imx8mm-lpddr4-evk"

# Things added by imx8mm-evk.inc that we're not interested in.
MACHINE_FEATURES:remove = "\
    bcm43455 \
    bcm4356 \
    bcm4359 \
    iw612 \
    jailhouse \
    nxp8987 \
    nxp8987 \
    nxp8987-sdio \
    nxp8997 \
    optee \
"
```

## conf/machine/imx8mp-goldilocks.conf
```bitbake
require conf/machine/imx8mp-ddr4-evk.conf

# MACHINEOVERRIDES =. "imx8mp-lpddr4-evk"
```
