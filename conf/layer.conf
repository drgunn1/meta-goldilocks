## conf/layer.conf
```bitbake
# We have a conf and classes directory, add to BBPATH
BBPATH .= ":${LAYERDIR}"

# We have recipes-* directories, add to BBFILES
BBFILES += "${LAYERDIR}/recipes-*/*/*.bb \
	${LAYERDIR}/recipes-*/*/*.bbappend"

BBFILE_COLLECTIONS += "meta-goldilocks"
BBFILE_PATTERN_meta-goldilocks= "^${LAYERDIR}/"
BBFILE_PRIORITY_meta-goldilocks = "50"

LAYERDEPENDS_meta-goldilocks = "\
    core \
    fsl-sdk-release \
    openembedded-layer \
    qt6-layer \
"
LAYERSERIES_COMPAT_meta-goldilocks = "walnascar "

KERNEL_DEVICETREE:append:fdc-mamabear = " \
	freescale/fdc-mamabear-rpi-7in-panel.dtb \
	freescale/fdc-mamabear-rpi-7in-panel-imx219cam.dtb \
	freescale/fdc-mamabear-ar0144.dtb \
	freescale/fdc-mamabear-ar0830.dtb \
"

BBMASK += "meta/recipes-devtools/pseudo/pseudo_git\.bb"
```
